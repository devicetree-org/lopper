/*
 * Copyright (c) 2019,2020 Xilinx Inc. All rights reserved.
 *
 * Author:
 *       Bruce Ashfield <bruce.ashfield@xilinx.com>
 *
 * SPDX-License-Identifier: BSD-3-Clause
 */

/dts-v1/;

/ {
        compatible = "system-device-tree-v1,lop";
        lops {
                compatible = "system-device-tree-v1,lop";
                lop_1 {
                        compatible = "system-device-tree-v1,lop,assist-v1";
                        node = "/chosen/domains";
                        id = "access-domain,domain-v1";
                        //noexec;
                };
        };
};
