/dts-v1/;
/ {
	compatible = "system-device-tree-v1,lop";
	lops {

		lop_3_3 {
			compatible = "system-device-tree-v1,lop,assist-v1";
			node = "/domains";
			id = "xlnx,output,cdo";
			options = "subsystem.cdo";
		};
	};

};
