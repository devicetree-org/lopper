/*
 * Copyright (c) 2020 Xilinx Inc. All rights reserved.
 *
 * Author:
 *	   Ben Levinsky <blevinsk@xilinx.com>
 *
 * this lop file will hold all the basic information for openamp use cases
 *
 * there should be reserved-mem, remoteproc driver code, interrupts,
 * shared mem resources and specify remote's information
 *
 *
 * SPDX-License-Identifier: BSD-3-Clause
 */


/dts-v1/;

/ {
	compatible = "system-device-tree-v1,lop";
	lops {
	/* common for both linux kernel or rpmsg userspace to rpus  */
	/* handle linux kernel space to rpus case */

		lop_5_1 {
			compatible = "system-device-tree-v1,lop,assist-v1";
			node = "/";
			id = "openamp,xlnx-rpu";

		};
	};
};
