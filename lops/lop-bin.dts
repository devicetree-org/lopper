/dts-v1/;

/ {
        compatible = "system-device-tree-v1";
        lops {
                compatible = "system-device-tree-v1,lop";
                lop_0 {
                        compatible = "system-device-tree-v1,lop,modify";
                        modify = "/:pnode-id:0x3";
                };
        };
};
