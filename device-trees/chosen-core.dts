/*
 * Copyright (c) 2019,2020 Xilinx Inc. All rights reserved.
 *
 * Author:
 *       Bruce Ashfield <bruce.ashfield@xilinx.com>
 *
 * SPDX-License-Identifier: BSD-3-Clause
 */

/ {
        compatible = "system-device-tree-v1";
        chosen {
               compatible = "foo";
               domains {
                       compatible = "domainspec,v1";
                       access = <&tcm 0x1>, <&ethernet0 0x0>;
               };
        };
};
