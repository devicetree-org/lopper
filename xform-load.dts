/dts-v1/;

/ {
        compatible = "system-device-tree-v1";
        // this means run it first
        priority = <1>;
        xforms {
                xform_0 {
                        compatible = "system-device-tree-v1,load,module";
                        module = "openamp,domain-v1";
                        load = "openamp.py";
                };
        };
};
