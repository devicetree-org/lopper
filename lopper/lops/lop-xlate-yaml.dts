/*
 * Copyright (c) 2021 Xilinx Inc. All rights reserved.
 *
 * Author:
 *       Bruce Ashfield <bruce.ashfield@xilinx.com>
 *
 * SPDX-License-Identifier: BSD-3-Clause
 *
 * DEPRECATED: This file is a backwards-compatibility stub.
 *
 * The functionality previously in this file has been moved to %.yaml.lop
 * which provides automatic YAML processing via BitBake-style pattern matching.
 *
 * This stub exists to prevent errors when external tools pass
 * "-i lop-xlate-yaml.dts" on the command line. The actual YAML processing
 * is handled by %.yaml.lop which matches any .yaml input file.
 *
 * To update your tooling:
 *   Old: lopper -i lop-xlate-yaml.dts -i domain.yaml ...
 *   New: lopper -x yaml -i domain.yaml ...
 *   Or:  lopper --auto -i domain.yaml ...
 */

/dts-v1/;

/ {
        compatible = "system-device-tree-v1,lop";
        lops {
                compatible = "system-device-tree-v1,lop";
                lop_xlate_yaml_deprecated {
                        compatible = "system-device-tree-v1,lop,code-v1";
                        code = "
                            import lopper
                            lopper.log._info('lop-xlate-yaml.dts is deprecated, YAML processing handled by %.yaml.lop')
                            return True
                        ";
                };
        };
};
