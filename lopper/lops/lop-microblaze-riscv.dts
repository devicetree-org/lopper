/*
 * Copyright (c) 2020 Xilinx Inc. All rights reserved.
 * Copyright (c) 2023 - 2026 Advanced Micro Devices, Inc. All rights reserved.
 * SPDX-License-Identifier: BSD-3-Clause
 *
 * @brief lop behavior summary
 *
 * Description:
 * - Computes MicroBlaze-RISC-V compiler/ISA flags from CPU feature properties for
 *   software build integration.
 *
 * Key Operations:
 * - select-v1, code-v1
 *
 * Notable Targets:
 * - /cpus_.\*cpu*.*:compatible:.*microblaze_riscv
 */

/dts-v1/;

/ {
        compatible = "system-device-tree-v1,lop";
        lops {
                lop_1_1 {
                      compatible = "system-device-tree-v1,lop,select-v1";
                      select_1;
                      select_2 = "/cpus_.*/cpu*.*:compatible:.*microblaze_riscv";
                      select_3 = ":xlnx,use-muldiv:!0";
                      lop_1_1_1 {
                          compatible = "system-device-tree-v1,lop,code-v1";
                          code = "
                               for n in tree.__selected__:
                                   n['xlnx,use-muldiv'].tunes = 'm'
                          ";
                      };
                };
                lop_2_1 {
                      compatible = "system-device-tree-v1,lop,select-v1";
                      select_1;
                      select_2 = "/cpus_.*/cpu*.*:compatible:.*microblaze_riscv";
                      select_3 = ":xlnx,use-atomic:!0";
                      lop_2_1_1 {
                          compatible = "system-device-tree-v1,lop,code-v1";
                          code = "
                              for n in __selected__:
                                   n['xlnx,use-atomic'].tunes = 'a'
                          ";
                      };
                };
                lop_3_1 {
                      compatible = "system-device-tree-v1,lop,select-v1";
                      select_1;
                      select_2 = "/cpus_.*/cpu*.*:compatible:.*microblaze_riscv";
                      select_3 = ":xlnx,use-fpu:!0";
                      lop_3_1_1 {
                          compatible = "system-device-tree-v1,lop,code-v1";
                          code = "
                               for n in tree.__selected__:
                                   if n['xlnx,use-fpu'].value[0] > 1:
                                       n['xlnx,use-fpu'].tunes = 'fd'
                                   else:
                                       n['xlnx,use-fpu'].tunes = 'f'
                          ";
                      };
                };
                lop_4_1 {
                      compatible = "system-device-tree-v1,lop,select-v1";
                      select_1;
                      select_2 = "/cpus_.*/cpu*.*:compatible:.*microblaze_riscv";
                      select_3 = ":xlnx,use-compression:1";
                      lop_4_1_1 {
                          compatible = "system-device-tree-v1,lop,code-v1";
                          code = "
                               for n in tree.__selected__:
                                   n['xlnx,use-compression'].tunes = 'c'
                          ";
                      };
                };


               lop_5_1 {
                      compatible = "system-device-tree-v1,lop,select-v1";
                      select_1;
                      select_2 = "/cpus_.*/cpu*.*:compatible:.*microblaze_riscv";
                      select_3 = ":xlnx,data-size:!0";
                      lop_5_1_1 {
                          compatible = "system-device-tree-v1,lop,code-v1";
                          code = "
                               from pprint import pprint
                               for n in tree.__selected__:
                                   pprint(vars(n['xlnx,data-size']))
                                   use_embedded = n.propval('xlnx,use-embedded')
                                   is_embedded = use_embedded != [''] and use_embedded[0] == 1
                                   if n['xlnx,data-size'].value[0] == 64:
                                       if is_embedded:
                                           print('WARNING: {}: xlnx,use-embedded is set but xlnx,data-size is 64; RV32E is a 32-bit-only ISA. Ignoring xlnx,use-embedded and generating rv64i flags.'.format(n.abs_path))
                                       n['xlnx,data-size'].tunes = 'rv64i'
                                   elif is_embedded:
                                       n['xlnx,data-size'].tunes = 'rv32e'
                                   else:
                                       n['xlnx,data-size'].tunes = 'rv32i'
                          ";
                      };
                };

                lop_output_tunes {
                      compatible = "system-device-tree-v1,lop,select-v1";
                      select_1;
                      select_2 = "/cpus_.*/cpu*.*:compatible:.*microblaze_riscv";
                      lop_output_code {
                           compatible = "system-device-tree-v1,lop,code-v1";
                           code = "
                               import yaml
                               import os

                               for n in tree.__selected__:
                                   use_embedded = n.propval('xlnx,use-embedded')
                                   is_embedded = use_embedded != [''] and use_embedded[0] == 1 and n['xlnx,data-size'].value[0] != 64
                                   fpu_conflict = is_embedded and n['xlnx,use-fpu'].value[0] != 0

                                   proplist= ['xlnx,data-size', 'xlnx,use-muldiv', 'xlnx,use-atomic', 'xlnx,use-fpu', 'xlnx,use-compression']
                                   if fpu_conflict:
                                       print('WARNING: {}: RV32E has no hard-float ABI; ignoring xlnx,use-fpu={}'.format(n.abs_path, n['xlnx,use-fpu'].value[0]))
                                       proplist.remove('xlnx,use-fpu')

                                   archflags = []
                                   bsp_archflags = []
                                   cflags_data = {}

                                   for property in proplist:
                                       try:
                                           archflags.append(n[property].tunes)
                                           bsp_archflags.append(n[property].tunes)
                                       except:
                                           continue


                                   if n['xlnx,use-bitman-a'].value[0] == 1 and n['xlnx,use-bitman-b'].value[0] == 1 and n['xlnx,use-bitman-s'].value[0] == 1:
                                       archflags.append('b')
                                       archflags.append('_zicsr_zifencei')
                                       bsp_archflags.append('b')
                                       bsp_archflags.append('_zicsr_zifencei')
                                   else:
                                       archflags.append('_zicsr_zifencei')
                                       bsp_archflags.append('_zicsr_zifencei')

                                       if n['xlnx,use-bitman-a'].value[0] == 1:
                                          archflags.append('_zba')
                                          bsp_archflags.append('_zba')

                                       if n['xlnx,use-bitman-b'].value[0] == 1:
                                          archflags.append('_zbb')
                                          bsp_archflags.append('_zbb')

                                       if n['xlnx,use-bitman-s'].value[0] == 1:
                                          archflags.append('_zbs')
                                          bsp_archflags.append('_zbs')


                                   if n['xlnx,use-bitman-c'].value[0] == 1:
                                       archflags.append('_zbc')
                                       bsp_archflags.append('_zbc')

                                   if n['xlnx,use-dcache'].value[0] == 1 or n['xlnx,use-icache'].value[0] == 1:
                                       archflags.append('_zicbom')
                                       bsp_archflags.append('_zicbom')

                                   if n['xlnx,data-size'].value[0] == 64:
                                       archflags.append(' -mabi=lp64')
                                       bsp_archflags.append(' -mabi=lp64')
                                   elif is_embedded:
                                       archflags.append(' -mabi=ilp32e')
                                       bsp_archflags.append(' -mabi=ilp32e')
                                   else:
                                       archflags.append(' -mabi=ilp32')
                                       bsp_archflags.append(' -mabi=ilp32')

                                   if not fpu_conflict:
                                       if n['xlnx,use-fpu'].value[0] == 1:
                                           archflags.append('f')
                                       elif n['xlnx,use-fpu'].value[0] == 2:
                                           archflags.append('d')

                                   archflags.insert(0, '-march=')
                                   bsp_archflags.insert(0, '-march=')
                                   n.tunes = archflags

                                   flags = ''.join(archflags) 
                                   bsp_linkflags = ''.join(bsp_archflags)
                                   mcmodel_flag = n.propval('xlnx,use-mcmodel')[0]
                                   if mcmodel_flag:
                                       flags += ' -mcmodel=' + mcmodel_flag
                                   cflags_data['cflags'] = flags
                                   cflags_data['linkflags'] = bsp_linkflags

                                   with open(os.path.join(outdir, 'cflags.yaml'), 'w') as fd:
                                         fd.write(yaml.dump(cflags_data, indent = 4))
                               ";
                      };
                };
        };
};
