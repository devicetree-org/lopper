/*
 * Copyright (c) 2026 Advanced Micro Devices, Inc.
 * SPDX-License-Identifier: BSD-3-Clause
 *
 * Zephyr-side wrapper for the sdt-from-linux pipeline.
 *
 * Includes the upstream Zephyr Versal RPU SoC dtsi
 * (amd/versal.dtsi + arm/xilinx/versal_rpu.dtsi) and adds the
 * minimum root metadata needed for compose_devices to identify the
 * tree's SoC family.
 *
 * The upstream Zephyr board file
 * (boards/amd/versal_rpu/versal_rpu.dts) would also work here, but
 * shipping a per-board wrapper keeps the input declarations under our
 * version control and matches the i.MX 8MM case below (whose upstream
 * board file depends on a pinctrl include from the hal_nxp Zephyr
 * module, not the main zephyr repo). Same shape across boards.
 *
 * The compose_devices pipeline extracts: the R5 CPU cluster, TCM
 * (128 KB ITCM, declared by arm/xilinx/versal_rpu.dtsi), OCM
 * (256 KB at 0xfffc0000, declared by amd/versal.dtsi), and the
 * RPU-side view of the LPD peripherals (UART0/1, TTC0..3, gpio).
 */

/dts-v1/;
#include <arm/xilinx/versal_rpu.dtsi>

/ {
	model = "Zephyr Versal RPU view (Cortex-R5)";
	compatible = "xlnx,versal-rpu", "xlnx,versal";
};
